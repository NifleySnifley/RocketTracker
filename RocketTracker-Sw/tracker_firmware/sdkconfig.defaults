## RocketTracker-Sw/tracker_firmware/sdkconfig.defaults
```kconfig
CONFIG_AUTOSTART_ARDUINO=n
CONFIG_FREERTOS_HZ=1000

CONFIG_MBEDTLS_PSK_MODES=y
CONFIG_MBEDTLS_KEY_EXCHANGE_PSK=y

CONFIG_BT_ENABLED=n
CONFIG_BT_BLUEDROID_ENABLED=n
CONFIG_BT_NIMBLE_ENABLED=n

# CONFIG_BTDM_CTRL_MODE_BLE_ONLY=y
# CONFIG_BTDM_CTRL_MODE_BR_EDR_ONLY=n
# CONFIG_BTDM_CTRL_MODE_BTDM=n

# 
# CONFIG_BT_NIMBLE_HCI_EVT_BUF_SIZE=70
# CONFIG_BT_NIMBLE_EXT_ADV=y
# 
# #CONFIG_BT_BLE_50_FEATURES_SUPPORTED=n
# #CONFIG_BT_BLE_42_FEATURES_SUPPORTED=y
# #CONFIG_BT_LE_50_FEATURE_SUPPORT=n
```
